## buildroot-2021.05/package/koala-capicxx-core-runtime/Config.in
```kconfig
config BR2_PACKAGE_KOALA_CAPICXX_CORE_RUNTIME
    bool "capicxx-core-runtime"
    help
        capicxx-core-runtime
        
```

## buildroot-2021.05/package/koala-capicxx-someip-runtime/Config.in
```kconfig
config BR2_PACKAGE_KOALA_CAPICXX_SOMEIP_RUNTIME
    bool "capicxx someip runtime"
    select BR2_PACKAGE_KOALA_CAPICXX_CORE_RUNTIME
    select BR2_PACKAGE_KOALA_DLT
    select BR2_PACKAGE_KOALA_VSOMEIP
    help
        capicxx-someip-runtime
```

## buildroot-2021.05/package/koala-dlt/Config.in
```kconfig
config BR2_PACKAGE_KOALA_DLT
	bool "Koala DLT daemon"
	help
		dlt-daemon for Koala project
```

## buildroot-2021.05/package/koala-keyboard/Config.in
```kconfig
config BR2_PACKAGE_KOALA_KEYBOARD
    bool "Koala keyboard service"
    help
      My simple C++ application.
```

## buildroot-2021.05/package/koala-lvgl-app/Config.in
```kconfig
config BR2_PACKAGE_KOALA_LVGL_APP
    bool "Koala LVGL application"
    help
        The Koala home application using frame buffer
```

## buildroot-2021.05/package/koala-vsomeip/Config.in
```kconfig
config BR2_PACKAGE_KOALA_VSOMEIP
    bool "Koala VSOME/IP service"
    depends on BR2_TOOLCHAIN_GCC_AT_LEAST_8
    select BR2_PACKAGE_CMAKE
    select BR2_PACKAGE_BOOST
    select BR2_PACKAGE_BOOST_SYSTEM
    select BR2_PACKAGE_BOOST_THREAD
    select BR2_PACKAGE_BOOST_FILESYSTEM
    help
      My simple C++ application.
```

## buildroot-2021.05/package/koala-wifi-ble/Config.in
```kconfig
config BR2_PACKAGE_KOALA_WIFI_BLE
	bool "Koala wifi ble service"
	select BR2_PACKAGE_KOALA_CAPICXX_SOMEIP_RUNTIME
	select BR2_PACKAGE_KOALA_VSOMEIP
	select BR2_PACKAGE_KOALA_DLT
	help
		Koala wifi ble service
```

## buildroot-2021.05/package/koala-wifi-manager/Config.in
```kconfig
config BR2_PACKAGE_KOALA_WIFI_MANAGER
    bool "Koala wifi service"
    select BR2_PACKAGE_KOALA_CAPICXX_SOMEIP_RUNTIME
	select BR2_PACKAGE_KOALA_VSOMEIP
	select BR2_PACKAGE_KOALA_DLT
	help
		Koala wifi service
```

## linux_5.10/drivers/koala/Kconfig
```kconfig
# SPDX-License-Identifier: GPL-2.0-only
#
# KOALA_PACKAGES configuration
#

menuconfig KOALA_PACKAGES
    tristate "Koala packages"
    help
        This package includes custom driver for Koala Device

if KOALA_PACKAGES

source "drivers/koala/multy-way-5d/Kconfig"

source "drivers/koala/st7567s-cog/Kconfig"

endif # KOALA_PACKAGES
```

## linux_5.10/drivers/koala/multy-way-5d/Kconfig
```kconfig
config MULTY_WAY_5D
    tristate "5 directions button support"
    help
        This driver support 5 directions button
    default y
```

## linux_5.10/drivers/koala/st7567s-cog/Kconfig
```kconfig
config ST7567S_COG
    tristate "LCD ST7567S 128x64 support"
    help
        This driver support LCD ST7567S 128x64
    default n
```

## linux_5.10/drivers/net/wireless/espressif/Kconfig
```kconfig
config WLAN_VENDOR_ESPRESSIF
    tristate "Espressif WLAN driver"
    depends on BT
    default y
    help 
        This driver support for ESP32
    
```
